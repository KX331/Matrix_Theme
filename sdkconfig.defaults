## sdkconfig.defaults
```kconfig
# Matrix_Theme Web管理系统默认配置
# 目标芯片ESP32-C3
CONFIG_IDF_TARGET="esp32c3"

# Flash配置 8MB
CONFIG_ESPTOOLPY_FLASHSIZE_8MB=y
CONFIG_ESPTOOLPY_FLASHSIZE="8MB"

# SPIFFS文件系统
CONFIG_SPIFFS_USE_MAGIC=y
CONFIG_SPIFFS_USE_MAGIC_LENGTH=y
CONFIG_SPIFFS_META_LENGTH=4

# HTTP服务器配置（支持大文件上传）
CONFIG_HTTPD_MAX_REQ_HDR_LEN=1024
CONFIG_HTTPD_MAX_URI_LEN=256
CONFIG_HTTPD_ERR_RESP_NO_DELAY=y
CONFIG_HTTPD_PURGE_BUF_LEN=2048

# 开启WiFi AP+STA模式
CONFIG_ESP_WIFI_SOFTAP_SUPPORT=y
CONFIG_ESP_WIFI_STA_DISCONNECTED_PM_ENABLE=n

# ADC校准
CONFIG_ADC_CAL_EFUSE_TP_ENABLE=y
CONFIG_ADC_ONESHOT_CTRL_FUNC_IN_IRAM=n

# 控制台USB JTAG（方便查看日志）
CONFIG_ESP_CONSOLE_USB_SERIAL_JTAG=y

# ==============================================================
# 小内存优化（ESP32-C3 无PSRAM，单用户AP场景）
# 默认 LWIP TCP 缓冲是为高带宽/多连接场景设计的，在 C3 上浪费 ~30KB RAM
# ==============================================================
# TCP 收发窗口缩小（小页面+AJAX场景下足够，每个TCP连接省约 9KB 内存）
CONFIG_LWIP_TCP_SND_BUF_DEFAULT=2920
CONFIG_LWIP_TCP_WND_DEFAULT=2920
CONFIG_LWIP_TCP_RECVMBOX_SIZE=4
CONFIG_LWIP_TCP_ACCEPTMBOX_SIZE=2
# UDP/MBOX 缩小
CONFIG_LWIP_UDP_RECVMBOX_SIZE=4
CONFIG_LWIP_TCPIP_RECVMBOX_SIZE=16
# WiFi AMPDU/AMSDU 关闭（省内存），单用户场景吞吐已足够
CONFIG_ESP_WIFI_AMPDU_TX_ENABLED=n
CONFIG_ESP_WIFI_AMSDU_TX_ENABLED=n
# HTTPD 动态缓冲保持小值
CONFIG_HTTPD_MAX_REQ_HDR_LEN=512
CONFIG_HTTPD_MAX_URI_LEN=128
CONFIG_HTTPD_PURGE_BUF_LEN=512
# NVS 单页模式省内存
CONFIG_NVS_ENCRYPTION=n
```
